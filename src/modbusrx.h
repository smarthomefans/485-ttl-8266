#include <PubSubClient.h>
#include <SoftwareSerial.h>


float _t15 = 15000000 / 115200; // 1T * 1.5 = T1.5
float _t35 = 35000000 / 115200;

uint8_t convert(char *src);

const byte _auchCRCHi[] = {
    0x00, 0xC1, 0x81, 0x40, 0x01, 0xC0, 0x80, 0x41, 0x01, 0xC0, 0x80, 0x41, 0x00, 0xC1, 0x81,
    0x40, 0x01, 0xC0, 0x80, 0x41, 0x00, 0xC1, 0x81, 0x40, 0x00, 0xC1, 0x81, 0x40, 0x01, 0xC0,
    0x80, 0x41, 0x01, 0xC0, 0x80, 0x41, 0x00, 0xC1, 0x81, 0x40, 0x00, 0xC1, 0x81, 0x40, 0x01,
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    0x00, 0xC1, 0x81, 0x40, 0x01, 0xC0, 0x80, 0x41, 0x01, 0xC0, 0x80, 0x41, 0x00, 0xC1, 0x81,
    0x40};

/* Table of CRC values for low order byte */
const byte _auchCRCLo[] = {
    0x00, 0xC0, 0xC1, 0x01, 0xC3, 0x03, 0x02, 0xC2, 0xC6, 0x06, 0x07, 0xC7, 0x05, 0xC5, 0xC4,
    0x04, 0xCC, 0x0C, 0x0D, 0xCD, 0x0F, 0xCF, 0xCE, 0x0E, 0x0A, 0xCA, 0xCB, 0x0B, 0xC9, 0x09,
    0x08, 0xC8, 0xD8, 0x18, 0x19, 0xD9, 0x1B, 0xDB, 0xDA, 0x1A, 0x1E, 0xDE, 0xDF, 0x1F, 0xDD,
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    0x44, 0x84, 0x85, 0x45, 0x87, 0x47, 0x46, 0x86, 0x82, 0x42, 0x43, 0x83, 0x41, 0x81, 0x80,
    0x40};

word calcCrc(byte address, byte *pduFrame, byte pduLen)
{
    byte CRCHi = 0xFF, CRCLo = 0x0FF, Index;

    Index = CRCHi ^ address;
    CRCHi = CRCLo ^ _auchCRCHi[Index];
    CRCLo = _auchCRCLo[Index];

    while (pduLen--)
    {
        Index = CRCHi ^ *pduFrame++;
        CRCHi = CRCLo ^ _auchCRCHi[Index];
        CRCLo = _auchCRCLo[Index];
    }

    return (CRCHi << 8) | CRCLo;
}

void sendsignal(SoftwareSerial *sfserial, char *msg)
{
    byte slaveid;
    byte controlstr[10] = {};
    char delimiter[] = ",";
    Serial.println("xx:" + String(msg));
    char *command = strtok(msg, delimiter);
    int index = 0;
    while (command != NULL)
    {
        if (index == 0)
        {
            slaveid = strtol(command, NULL, 10);
        }
        else
        {
            controlstr[index - 1] = strtol(command, NULL, 10);
        }
        command = strtok(NULL, delimiter);
        index++;
    }
    
    word crc = calcCrc(slaveid, controlstr, index - 1);
    sfserial->write(slaveid);
    int size = sfserial->write(&controlstr[0], index - 1);
    sfserial->write(crc >> 8);
    sfserial->write(crc & 0xFF);
    sfserial->flush();
    Serial.println("xxx" + String(slaveid));
    Serial.println("xxx" + String(size));
    Serial.println("xxx1: " + String(crc >> 8));
    Serial.println("xxx2: " + String(crc & 0xFF));
    delayMicroseconds(_t35);
}

String *byteToHexStr(unsigned char byte_arr[], int arr_len)
{
    String *hexstr = new String();
    for (int i = 0; i < arr_len; i++)
    {
        char hex1;
        char hex2;
        int value = byte_arr[i];
        int v1 = value / 16;
        int v2 = value % 16;

        if (v1 >= 0 && v1 <= 9)
            hex1 = (char)(48 + v1);
        else
            hex1 = (char)(55 + v1);

        if (v2 >= 0 && v2 <= 9)
            hex2 = (char)(48 + v2);
        else
            hex2 = (char)(55 + v2);

        *hexstr = *hexstr + hex1 + hex2;
    }
    return hexstr;
}

String *byteToHexStr(char byte_arr[], int arr_len)
{
    String *hexstr = new String();
    for (int i = 0; i < arr_len; i++)
    {
        char hex1;
        char hex2;
        int value = byte_arr[i];
        int v1 = value / 16;
        int v2 = value % 16;

        if (v1 >= 0 && v1 <= 9)
            hex1 = (char)(48 + v1);
        else
            hex1 = (char)(55 + v1);

        if (v2 >= 0 && v2 <= 9)
            hex2 = (char)(48 + v2);
        else
            hex2 = (char)(55 + v2);

        *hexstr = *hexstr + hex1 + hex2;
    }
    return hexstr;
}

uint8_t convert(char *src)
{
    uint8_t ret = 0, d;
    while (*src)
    {
        if (*src >= '0' && *src <= '9')
            d = *src - '0';
        else if (*src >= 'a' && *src <= 'f')
            d = *src - 'a' + 10;
        else if (*src >= 'A' && *src <= 'Z')
            d = *src - 'A' + 10;

        ret = ret * 16 + d;
        src++;
    }
    return ret;
}
void modbustask(SoftwareSerial *sfserial)
{
    int _len = 0;
    char *_frame = {};
    while ((*sfserial).available() > _len)
    {
        _len = (*sfserial).available();
        delayMicroseconds(_t15);
    }

    if (_len == 0)
        return;

    byte i;
    _frame = (char *)malloc(_len);
    for (i = 0; i < _len; i++)
        _frame[i] = (*sfserial).read();
    if (_len > 0)
    {
        String callbackstr = *byteToHexStr(_frame, _len);
        Serial.print("callback:");
        Serial.println(callbackstr);
    }
    free(_frame);
    _len = 0;
}